## package/wdpackage_basic/Config.in
```kconfig
config BR2_PACKAGE_WDPACKAGE_BASIC
	bool "wdpackage(basic)"
    depends on BR2_PACKAGE_NETATALK
	help
	  The wd package(basic) setup required environment for WD packages

if BR2_PACKAGE_WDPACKAGE_BASIC
config BR2_TOOLCHAIN_EXTRA_EXTERNAL_LIBS
    default "libthread_db.so"
endif
```

## package/wdpackage_basic_korra_dock/Config.in
```kconfig
config BR2_PACKAGE_WDPACKAGE_BASIC_KORRA_DOCK
	bool "wdpackage(basic) for korra dock"
	help
	  The wd package(basic) korra dock setup required environment for WD packages
```

## package/wilink8-utils/Config.in
```kconfig
config BR2_PACKAGE_WILINK8_UTILS
	bool "wilink8-utils(ti-wl18xx)"
    depends on BR2_PACKAGE_WILINK8 
    depends on BR2_PACKAGE_LIBNL
	select BR2_PACKAGE_NCURSES
	help
      Texas Instrument's WiLink™ 8.0 offers high performance and low energy solutions to WLAN, Bluetooth® and BLE applications.
      The WL18xx single-chip module encompasses all digital and analog content required for multiple radio technologies.

      http://processors.wiki.ti.com/index.php/WL18xx
```

## package/wilink8/Config.in
```kconfig
config BR2_PACKAGE_WILINK8
	bool "wilink8(ti-wl18xx)"
    depends on BR2_LINUX_KERNEL
	select BR2_PACKAGE_NCURSES
	help
      Texas Instrument's WiLink™ 8.0 offers high performance and low energy solutions to WLAN, Bluetooth® and BLE applications.
      The WL18xx single-chip module encompasses all digital and analog content required for multiple radio technologies.

      http://processors.wiki.ti.com/index.php/WL18xx
```

## project/korra_fwupg/configs/korra_fwupg_defconfig
```kconfig
BR2_arm=y
BR2_cortex_a8=y
BR2_DEFCONFIG="$(CONFIG_DIR)/defconfig"
BR2_TOOLCHAIN_EXTERNAL=y
BR2_ENABLE_LOCALE_PURGE=y
BR2_ENABLE_LOCALE_WHITELIST="C"
BR2_TARGET_GENERIC_HOSTNAME="Korra"
BR2_TARGET_GENERIC_ISSUE="Welcome to WD Korra Fwupg"
BR2_ROOTFS_DEVICE_CREATION_DYNAMIC_MDEV=y
BR2_TARGET_GENERIC_ROOT_PASSWD="welcome"
BR2_ROOTFS_POST_BUILD_SCRIPT="project/prjPatches/remove_unused_rootfs.sh"
BR2_LINUX_KERNEL=y
BR2_LINUX_KERNEL_CUSTOM_TARBALL=y
BR2_LINUX_KERNEL_CUSTOM_TARBALL_LOCATION="linux-kernel.tgz"
BR2_LINUX_KERNEL_PATCH="$(TOPDIR)/project/prjPatches/*_korra_fwupg_knl.patch"
BR2_LINUX_KERNEL_USE_CUSTOM_CONFIG=y
BR2_LINUX_KERNEL_CUSTOM_CONFIG_FILE="$(TOPDIR)/project/prjConfigs/linux-fwupg.config"
BR2_LINUX_KERNEL_DTS_SUPPORT=y
BR2_LINUX_KERNEL_INTREE_DTS_NAME="rtd-119x-nas-rescue"
BR2_PACKAGE_BUSYBOX_CONFIG="$(TOPDIR)/project/prjConfigs/busybox-1.23Fwupg.x.config"
BR2_PACKAGE_BUSYBOX_SHOW_OTHERS=y
BR2_PACKAGE_HDPARM=y
BR2_PACKAGE_PMXPACKAGE_MCU_DAEMON=y
BR2_PACKAGE_PMXPACKAGE_ASMUPDATE=y
BR2_PACKAGE_PMXPACKAGE_FWUPGFS=y
BR2_TARGET_ROOTFS_CPIO=y
BR2_TARGET_ROOTFS_CPIO_LZMA=y
BR2_TARGET_ROOTFS_INITRAMFS=y
# BR2_TARGET_ROOTFS_TAR is not set
```

## project/korra_rescue/configs/korra_rescue_defconfig
```kconfig
BR2_arm=y
BR2_cortex_a8=y
BR2_DEFCONFIG="$(CONFIG_DIR)/defconfig"
BR2_TOOLCHAIN_EXTERNAL=y
BR2_ENABLE_LOCALE_PURGE=y
BR2_ENABLE_LOCALE_WHITELIST="C"
BR2_TARGET_GENERIC_HOSTNAME="Korra"
BR2_TARGET_GENERIC_ISSUE="Welcome to WD Korra Recovery"
BR2_ROOTFS_DEVICE_CREATION_DYNAMIC_MDEV=y
BR2_TARGET_GENERIC_ROOT_PASSWD="welcome"
BR2_ROOTFS_POST_BUILD_SCRIPT="project/prjPatches/remove_unused_rootfs.sh"
BR2_LINUX_KERNEL=y
BR2_LINUX_KERNEL_CUSTOM_TARBALL=y
BR2_LINUX_KERNEL_CUSTOM_TARBALL_LOCATION="linux-kernel.tgz"
BR2_LINUX_KERNEL_PATCH="$(TOPDIR)/project/prjPatches/*_korra_rescue_knl.patch"
BR2_LINUX_KERNEL_USE_CUSTOM_CONFIG=y
BR2_LINUX_KERNEL_CUSTOM_CONFIG_FILE="$(TOPDIR)/project/prjConfigs/linux-rescue.config"
BR2_LINUX_KERNEL_DTS_SUPPORT=y
BR2_LINUX_KERNEL_INTREE_DTS_NAME="rtd-119x-nas-rescue"
BR2_PACKAGE_BUSYBOX_CONFIG="$(TOPDIR)/project/prjConfigs/busybox-1.23Recovery.x.config"
BR2_PACKAGE_BUSYBOX_SHOW_OTHERS=y
BR2_PACKAGE_DOSFSTOOLS=y
BR2_PACKAGE_DOSFSTOOLS_MKFS_FAT=y
BR2_PACKAGE_DOSFSTOOLS_FSCK_FAT=y
BR2_PACKAGE_E2FSPROGS=y
# BR2_PACKAGE_E2FSPROGS_BADBLOCKS is not set
# BR2_PACKAGE_E2FSPROGS_DUMPE2FS is not set
# BR2_PACKAGE_E2FSPROGS_E2FREEFRAG is not set
# BR2_PACKAGE_E2FSPROGS_E2IMAGE is not set
# BR2_PACKAGE_E2FSPROGS_E2UNDO is not set
# BR2_PACKAGE_E2FSPROGS_FILEFRAG is not set
# BR2_PACKAGE_E2FSPROGS_MKLOSTFOUND is not set
# BR2_PACKAGE_E2FSPROGS_RESIZE2FS is not set
BR2_PACKAGE_HDPARM=y
BR2_PACKAGE_MTD=y
# BR2_PACKAGE_MTD_DOCFDISK is not set
# BR2_PACKAGE_MTD_FLASH_OTP_WRITE is not set
# BR2_PACKAGE_MTD_NANDDUMP is not set
# BR2_PACKAGE_MTD_NANDTEST is not set
# BR2_PACKAGE_MTD_NANDWRITE is not set
# BR2_PACKAGE_MTD_UBIATTACH is not set
# BR2_PACKAGE_MTD_UBICRC32 is not set
# BR2_PACKAGE_MTD_UBIDETACH is not set
# BR2_PACKAGE_MTD_UBIFORMAT is not set
# BR2_PACKAGE_MTD_UBIMKVOL is not set
# BR2_PACKAGE_MTD_UBINFO is not set
# BR2_PACKAGE_MTD_UBINIZE is not set
# BR2_PACKAGE_MTD_UBIRENAME is not set
# BR2_PACKAGE_MTD_UBIRMVOL is not set
# BR2_PACKAGE_MTD_UBIRSVOL is not set
# BR2_PACKAGE_MTD_UBIUPDATEVOL is not set
BR2_PACKAGE_ZLIB=y
BR2_PACKAGE_PARAGON_UFSD=y
BR2_PACKAGE_PMXPACKAGE_MCU_DAEMON=y
BR2_PACKAGE_PMXPACKAGE_ASMUPDATE=y
BR2_PACKAGE_PMXPACKAGE_RESCUEFS=y
BR2_TARGET_ROOTFS_CPIO=y
BR2_TARGET_ROOTFS_CPIO_LZMA=y
BR2_TARGET_ROOTFS_INITRAMFS=y
# BR2_TARGET_ROOTFS_TAR is not set
```

## project/korra_spi/configs/korra_spi_defconfig
```kconfig
BR2_arm=y
BR2_cortex_a7=y
BR2_ARM_EABIHF=y
BR2_ARM_FPU_NEON_VFPV4=y
BR2_DEFCONFIG="$(CONFIG_DIR)/defconfig"
BR2_STRIP_EXCLUDE_DIRS="usr/local/twonkymedia-7"
BR2_TOOLCHAIN_EXTERNAL=y
BR2_ENABLE_LOCALE_PURGE=y
BR2_ENABLE_LOCALE_WHITELIST="C en_US"
BR2_GENERATE_LOCALE="zh_TW.UTF-8 en_US.UTF-8 zh_CN.UTF-8 cs_CZ.UTF-8 de_DE.UTF-8 es_ES.UTF-8 fr_FR.UTF-8 hu_HU.UTF-8 it_IT.UTF-8 ja_JP.UTF-8 ko_KR.UTF-8 nb_NO.UTF-8 pl_PL.UTF-8 pt_BR.UTF-8 ru_RU.UTF-8 sv_SE.UTF-8 nl_NL.UTF-8 tr_TR.UTF-8"
BR2_TARGET_GENERIC_HOSTNAME="MyPassport"
BR2_TARGET_GENERIC_ISSUE="Welcome to My Passport"
BR2_INIT_SYSTEMD=y
BR2_TARGET_GENERIC_ROOT_PASSWD="welc0me"
BR2_SYSTEM_BIN_SH_BASH=y
BR2_TARGET_TZ_INFO=y
BR2_ROOTFS_POST_BUILD_SCRIPT="./project/prjPatches/build_image_script.sh"
BR2_LINUX_KERNEL=y
BR2_LINUX_KERNEL_CUSTOM_TARBALL=y
BR2_LINUX_KERNEL_CUSTOM_TARBALL_LOCATION="linux-kernel.tgz"
BR2_LINUX_KERNEL_PATCH="$(TOPDIR)/project/prjPatches/*_korra_spi_knl.patch"
BR2_LINUX_KERNEL_USE_CUSTOM_CONFIG=y
BR2_LINUX_KERNEL_CUSTOM_CONFIG_FILE="$(TOPDIR)/project/prjConfigs/linux-spi.config"
BR2_LINUX_KERNEL_DTS_SUPPORT=y
BR2_LINUX_KERNEL_INTREE_DTS_NAME="rtd-119x-pmx rtd-119x-pmxkl"
BR2_PACKAGE_BUSYBOX_CONFIG="package/busybox/busybox-1.23KorraSPI.x.config"
BR2_PACKAGE_COREUTILS=y
BR2_PACKAGE_INFOZIP=y
BR2_PACKAGE_GDB=y
BR2_PACKAGE_GDB_DEBUGGER=y
BR2_PACKAGE_KEXEC=y
BR2_PACKAGE_KEXEC_ZLIB=y
BR2_PACKAGE_STRACE=y
BR2_PACKAGE_BINUTILS=y
BR2_PACKAGE_BINUTILS_TARGET=y
BR2_PACKAGE_LIBTOOL=y
BR2_PACKAGE_DOSFSTOOLS=y
BR2_PACKAGE_DOSFSTOOLS_MKFS_FAT=y
BR2_PACKAGE_DOSFSTOOLS_FSCK_FAT=y
BR2_PACKAGE_E2FSPROGS=y
BR2_PACKAGE_E2FSPROGS_RESIZE2FS=y
BR2_PACKAGE_EXFAT_UTILS=y
BR2_PACKAGE_MTD=y
BR2_PACKAGE_MTD_DOCFDISK=y
BR2_PACKAGE_MTD_FLASH_OTP_WRITE=y
# BR2_PACKAGE_MTD_NANDDUMP is not set
# BR2_PACKAGE_MTD_NANDTEST is not set
# BR2_PACKAGE_MTD_NANDWRITE is not set
# BR2_PACKAGE_MTD_UBIATTACH is not set
# BR2_PACKAGE_MTD_UBICRC32 is not set
# BR2_PACKAGE_MTD_UBIDETACH is not set
# BR2_PACKAGE_MTD_UBIFORMAT is not set
# BR2_PACKAGE_MTD_UBIMKVOL is not set
# BR2_PACKAGE_MTD_UBINFO is not set
# BR2_PACKAGE_MTD_UBINIZE is not set
# BR2_PACKAGE_MTD_UBIRENAME is not set
# BR2_PACKAGE_MTD_UBIRMVOL is not set
# BR2_PACKAGE_MTD_UBIRSVOL is not set
# BR2_PACKAGE_MTD_UBIUPDATEVOL is not set
BR2_PACKAGE_NTFS_3G=y
BR2_PACKAGE_NTFS_3G_NTFSPROGS=y
BR2_PACKAGE_GPTFDISK=y
BR2_PACKAGE_HDPARM=y
BR2_PACKAGE_PARTED=y
BR2_PACKAGE_SDPARM=y
BR2_PACKAGE_SIMPLE_MTPFS=y
BR2_PACKAGE_SMARTMONTOOLS=y
BR2_PACKAGE_UBOOT_TOOLS=y
BR2_PACKAGE_USBUTILS=y
BR2_PACKAGE_GPHOTOFS=y
BR2_PACKAGE_IFUSE=y
BR2_PACKAGE_USBMUXD=y
BR2_PACKAGE_ATOP=y
BR2_PACKAGE_PHP=y
BR2_PACKAGE_PHP_EXT_APC=y
BR2_PACKAGE_PHP_EXT_MCRYPT=y
BR2_PACKAGE_PHP_EXT_MHASH=y
BR2_PACKAGE_PHP_EXT_MBSTRING=y
BR2_PACKAGE_PHP_EXT_PEAR=y
BR2_PACKAGE_PHP_EXT_FILEINFO=y
BR2_PACKAGE_PHP_EXT_READLINE=y
BR2_PACKAGE_PHP_EXT_BZIP2=y
BR2_PACKAGE_PHP_EXT_HASH=y
BR2_PACKAGE_PHP_EXT_OPENSSL=y
BR2_PACKAGE_PHP_EXT_SQLITE=y
BR2_PACKAGE_PHP_EXT_SQLITE_UTF8=y
BR2_PACKAGE_PHP_EXT_PDO=y
BR2_PACKAGE_PHP_EXT_PDO_SQLITE=y
BR2_PACKAGE_PHP_EXT_GETTEXT=y
BR2_PACKAGE_PHP_EXT_ICONV=y
BR2_PACKAGE_PHP_EXT_EXIF=y
BR2_PACKAGE_PHP_EXT_BCMATH=y
BR2_PACKAGE_PHP_EXT_JSON=y
BR2_PACKAGE_PHP_EXT_TOKENIZER=y
BR2_PACKAGE_PHP_EXT_CURL=y
BR2_PACKAGE_PHP_EXT_SOCKETS=y
BR2_PACKAGE_PHP_EXT_CTYPE=y
BR2_PACKAGE_PHP_EXT_FILTER=y
BR2_PACKAGE_PHP_EXT_XMLRPC=y
BR2_PACKAGE_PHP_EXT_DOM=y
BR2_PACKAGE_PHP_EXT_SIMPLEXML=y
BR2_PACKAGE_PHP_EXT_XML=y
BR2_PACKAGE_PHP_EXT_XMLREADER=y
BR2_PACKAGE_PHP_EXT_XMLWRITER=y
BR2_PACKAGE_PHP_SAPI_CLI_CGI=y
BR2_PACKAGE_PYTHON=y
BR2_PACKAGE_PYTHON_PY_ONLY=y
BR2_PACKAGE_PYTHON_CURSES=y
BR2_PACKAGE_PYTHON_SSL=y
BR2_PACKAGE_PYTHON_SQLITE=y
BR2_PACKAGE_PYTHON_ZLIB=y
BR2_PACKAGE_PYTHON_HASHLIB=y
BR2_PACKAGE_NETTLE=y
BR2_PACKAGE_OPENSSL_BIN=y
BR2_PACKAGE_SQLITE_READLINE=y
BR2_PACKAGE_SQLITE_STAT3=y
BR2_PACKAGE_SQLITE_ENABLE_FTS3=y
BR2_PACKAGE_SQLITE_ENABLE_UNLOCK_NOTIFY=y
BR2_PACKAGE_SQLITE_SECURE_DELETE=y
BR2_PACKAGE_STRESS=y
BR2_PACKAGE_LIBCONFUSE=y
BR2_PACKAGE_LIBFUSE=y
BR2_PACKAGE_LIBMTP=y
BR2_PACKAGE_LIBIMOBILEDEVICE=y
BR2_PACKAGE_LIBGPHOTO2=y
BR2_PACKAGE_MXML=y
BR2_PACKAGE_CURL=y
BR2_PACKAGE_LIBNL_TOOLS=y
BR2_PACKAGE_LIBUPNP=y
BR2_PACKAGE_ICU=y
BR2_PACKAGE_PCRE_16=y
BR2_PACKAGE_PCRE_32=y
BR2_PACKAGE_MCRYPT=y
BR2_PACKAGE_APACHE=y
BR2_PACKAGE_APACHE_EXT_MOD_XSENDFILE=y
BR2_PACKAGE_AVAHI=y
BR2_PACKAGE_AVAHI_DAEMON=y
BR2_PACKAGE_AVAHI_LIBDNSSD_COMPATIBILITY=y
BR2_PACKAGE_BRIDGE_UTILS=y
BR2_PACKAGE_DHCP=y
BR2_PACKAGE_DHCP_SERVER=y
BR2_PACKAGE_DHCP_RELAY=y
BR2_PACKAGE_DHCP_CLIENT=y
BR2_PACKAGE_DHCP_WITHOUT_ROUTERS=y
BR2_PACKAGE_DNSMASQ=y
# BR2_PACKAGE_DNSMASQ_TFTP is not set
# BR2_PACKAGE_DNSMASQ_DHCP is not set
BR2_PACKAGE_HOSTAPD_EAP=y
BR2_PACKAGE_HOSTAPD_WPS=y
BR2_PACKAGE_IFPLUGD=y
BR2_PACKAGE_IFTOP=y
BR2_PACKAGE_IPERF=y
BR2_PACKAGE_IPTABLES=y
BR2_PACKAGE_IW=y
BR2_PACKAGE_LLD2D=y
BR2_PACKAGE_NET_TOOLS=y
BR2_PACKAGE_NET_TOOLS_NETSTAT=y
BR2_PACKAGE_NETATALK=y
BR2_PACKAGE_OPENSSH=y
BR2_PACKAGE_RSYNC=y
BR2_PACKAGE_SAMBA=y
# BR2_PACKAGE_SAMBA_EVENTLOGADM is not set
# BR2_PACKAGE_SAMBA_NET is not set
# BR2_PACKAGE_SAMBA_NMBLOOKUP is not set
# BR2_PACKAGE_SAMBA_NTLM_AUTH is not set
# BR2_PACKAGE_SAMBA_PDBEDIT is not set
# BR2_PACKAGE_SAMBA_PROFILES is not set
# BR2_PACKAGE_SAMBA_RPCCLIENT is not set
# BR2_PACKAGE_SAMBA_SMBCACLS is not set
# BR2_PACKAGE_SAMBA_SMBCONTROL is not set
# BR2_PACKAGE_SAMBA_SMBCQUOTAS is not set
# BR2_PACKAGE_SAMBA_SMBGET is not set
# BR2_PACKAGE_SAMBA_SMBLDBTOOLS is not set
# BR2_PACKAGE_SAMBA_SMBSHARESEC is not set
# BR2_PACKAGE_SAMBA_SMBSPOOL is not set
# BR2_PACKAGE_SAMBA_SMBTREE is not set
# BR2_PACKAGE_SAMBA_SWAT is not set
# BR2_PACKAGE_SAMBA_SMBTA_UTIL is not set
# BR2_PACKAGE_SAMBA_TDB is not set
# BR2_PACKAGE_SAMBA_TESTPARM is not set
# BR2_PACKAGE_SAMBA_WINBINDD is not set
# BR2_PACKAGE_SAMBA_AVAHI is not set
BR2_PACKAGE_TCPDUMP=y
BR2_PACKAGE_TCPDUMP_SMB=y
BR2_PACKAGE_VSFTPD=y
BR2_PACKAGE_WIRELESS_TOOLS=y
BR2_PACKAGE_WPA_SUPPLICANT_EAP=y
BR2_PACKAGE_WPA_SUPPLICANT_CLI=y
BR2_PACKAGE_WPA_SUPPLICANT_PASSPHRASE=y
BR2_PACKAGE_WPA_SUPPLICANT_AP_SUPPORT=y
BR2_PACKAGE_WPA_SUPPLICANT_WPS=y
BR2_PACKAGE_DPKG=y
BR2_PACKAGE_FILE=y
BR2_PACKAGE_LOGROTATE=y
BR2_PACKAGE_SHADOW=y
BR2_PACKAGE_SUDO=y
BR2_PACKAGE_IOTOP=y
BR2_PACKAGE_LSB=y
BR2_PACKAGE_PROCPS_NG=y
BR2_PACKAGE_RSYSLOG=y
BR2_PACKAGE_UTIL_LINUX_BINARIES=y
BR2_PACKAGE_UTIL_LINUX_SCHEDUTILS=y
BR2_PACKAGE_NANO=y
BR2_PACKAGE_WDPACKAGE_BASIC=y
BR2_PACKAGE_WDPACKAGE_MEDIACRAWLER=y
BR2_PACKAGE_WDPACKAGE_NOTIFIER=y
BR2_PACKAGE_WDPACKAGE_RESTAPI=y
BR2_PACKAGE_WDPACKAGE_WEBUI=y
BR2_PACKAGE_WDPACKAGE_TWONKYSERVER=y
BR2_PACKAGE_WDPACKAGE_PLEXMEDIASERVER=y
BR2_PACKAGE_WDPACKAGE_PLEXMEDIASERVER_INSTALL_PACKAGE=y
BR2_PACKAGE_PARAGON_UFSD=y
BR2_PACKAGE_PARAGON_TOOLS=y
BR2_PACKAGE_PMXPACKAGE_FWDESCRIPTOR=y
BR2_PACKAGE_PMXPACKAGE_GHELPER=y
BR2_PACKAGE_PMXPACKAGE_MCU_DAEMON=y
BR2_PACKAGE_PMXPACKAGE_MPTOOL=y
BR2_PACKAGE_PMXPACKAGE_MONITOR=y
BR2_PACKAGE_PMXPACKAGE_ASMUPDATE=y
BR2_PACKAGE_PMXPACKAGE_ASMUPDATE_STATIC=y
BR2_PACKAGE_PMXPACKAGE_SCSIGETCID=y
BR2_PACKAGE_PMXPACKAGE_HIDDENFILE=y
BR2_PACKAGE_PMXPACKAGE_DEFAULTSETTINGS=y
BR2_PACKAGE_PMXPACKAGE_PMXCACHE=y
BR2_PACKAGE_RTKPACKAGE_BOOTCODE=y
BR2_PACKAGE_RTKPACKAGE_RTL8189ES=y
BR2_PACKAGE_RTKPACKAGE_RTL8811AU=y
BR2_PACKAGE_RTKPACKAGE_HOSTAPD=y
BR2_PACKAGE_RTKPACKAGE_WPA_SUPPLICANT=y
BR2_PACKAGE_RTKPACKAGE_PARAGON=y
BR2_TARGET_ROOTFS_TAR_GZIP=y
```
