## package/pmxpackage_fwupgfs/Config.in
```kconfig
config BR2_PACKAGE_PMXPACKAGE_FWUPGFS
	bool "pmxpackage(fwupgfs)"
	help
	  The pmx package(fwupgfs) setup required environment for fwupg mode
```

## package/pmxpackage_ghelper/Config.in
```kconfig
config BR2_PACKAGE_PMXPACKAGE_GHELPER
	bool "pmxpackage(ghelper)"
	help
	  The primax package(ghelper) button and gpio for Avatar device
```

## package/pmxpackage_hiddenFile/Config.in
```kconfig
config BR2_PACKAGE_PMXPACKAGE_HIDDENFILE
	bool "pmxpackage(hiddenFile)"
	help
	  The primax package(hiddenFile) hidden folder and files for Avatar device
```

## package/pmxpackage_mcu_daemon/Config.in
```kconfig
config BR2_PACKAGE_PMXPACKAGE_MCU_DAEMON
	bool "pmxpackage(mcu_deamon)"
	help
	  The primax package(mcu_deamon) MCU communication for Avatar device
```

## package/pmxpackage_monitor/Config.in
```kconfig
config BR2_PACKAGE_PMXPACKAGE_MONITOR
	bool "pmxpackage(monitor)"
	help
	  The primax package(monitor) Monitor SMART status and Disk free spaces for Avatar device
```

## package/pmxpackage_mptool/Config.in
```kconfig
config BR2_PACKAGE_PMXPACKAGE_MPTOOL
	bool "pmxpackage(mptool)"
	help
	  The primax package(mptool) MP tools for Avatar device
```

## package/pmxpackage_pmxcache/Config.in
```kconfig
config BR2_PACKAGE_PMXPACKAGE_PMXCACHE
	bool "pmxpackage(pmxcache)"
	help
	  The primax package(pmxcache) cache module for Korra
```

## package/pmxpackage_rescuefs/Config.in
```kconfig
config BR2_PACKAGE_PMXPACKAGE_RESCUEFS
	bool "pmxpackage(rescuefs)"
	help
	  The pmx package(rescuefs) setup required environment for rescue mode

if BR2_PACKAGE_PMXPACKAGE_RESCUEFS
config BR2_PACKAGE_PMXPACKAGE_RESCUEFS_MASTERDRIVE
    bool "Include tools for MasterDrive"
    help
      Include tools for MasterDrive

endif
```

## package/pmxpackage_scsiGetCID/Config.in
```kconfig
config BR2_PACKAGE_PMXPACKAGE_SCSIGETCID
	bool "pmxpackage(scsiGetCID)"
	help
	  The primax package(scsiGetCID) SCSI get SD Card CID tool for Avatar device
```

## package/rtkpackage_bootcode/Config.in
```kconfig
config BR2_PACKAGE_RTKPACKAGE_BOOTCODE
	bool "bootcode"
if BR2_PACKAGE_RTKPACKAGE_BOOTCODE
choice
    prompt "U-boot configuration"
    default BR2_PACKAGE_RTKPACKAGE_BOOTCODE_KORRA
	config BR2_PACKAGE_RTKPACKAGE_BOOTCODE_KORRA
		bool "Korra"
	config BR2_PACKAGE_RTKPACKAGE_BOOTCODE_KORRA_LITE
		bool "Korra Lite"
	config BR2_PACKAGE_RTKPACKAGE_BOOTCODE_KORRA_DOCK
		bool "Korra Dock"
endchoice
endif
```

## package/rtkpackage_paragon/Config.in
```kconfig
config BR2_PACKAGE_RTKPACKAGE_PARAGON
	bool "rtkparagon"
	help
		RTK Paragon filesystem driver
```

## package/rtkpackage_rtl8189es/Config.in
```kconfig
config BR2_PACKAGE_RTKPACKAGE_RTL8189ES
	bool "rtl8189es"
	help
		RTK wifi 8189es driver
```

## package/rtkpackage_rtl8811au/Config.in
```kconfig
config BR2_PACKAGE_RTKPACKAGE_RTL8811AU
	bool "rtl8811au"
	help
		RTK wifi 8811au driver
```

## package/shadow/Config.in
```kconfig
config BR2_PACKAGE_SHADOW
	bool "shadow"
	help
	  The shadow-utils package includes the necessary programs for
	  converting UNIX password files to the shadow password format, plus
	  programs for managing user and group accounts. The pwconv command
	  converts passwords to the shadow password format. The pwunconv command
	  unconverts shadow passwords and generates an npasswd file (a standard
	  UNIX password file). The pwck command checks the integrity of password
	  and shadow files. The lastlog command prints out the last login times
	  for all users. The useradd, userdel, and usermod commands are used for
	  managing user accounts. The groupadd, groupdel, and groupmod commands
	  are used for managing group accounts.
```

## package/simple-mtpfs/Config.in
```kconfig
config BR2_PACKAGE_SIMPLE_MTPFS
	depends on BR2_PACKAGE_LIBMTP
    select BR2_PACKAGE_LIBGLIB2
    bool "simple-mtpfs"
	help
	  simple MTPfs is a FUSE filesystem that supports reading and writing from any MTP device (as supported by libmtp)

	  https://github.com/phatina/simple-mtpfs

	
```

## package/tre/Config.in
```kconfig
config BR2_PACKAGE_TRE
	bool "tre"
	help
	  TRE is a lightweight, robust, and efficient POSIX compliant regexp matching library.

	  http://linux.softpedia.com/get/Programming/Libraries/TRE-11116.shtml
```

## package/usbmuxd/Config.in
```kconfig
config BR2_PACKAGE_USBMUXD
	depends on BR2_PACKAGE_LIBUSB_COMPAT
	depends on BR2_PACKAGE_LIBUSB
	select BR2_PACKAGE_LIBUSBMUXD
	select BR2_PACKAGE_LIBPLIST
	bool "usbmuxd"
	help
	  A socket daemon to multiplex connections from and to iOS devices.

	  https://github.com/libimobiledevice/usbmuxd.git
```

## package/wd-forked-daapd/Config.in
```kconfig
config BR2_PACKAGE_WD_FORKED_DAAPD
    bool "wd-forked-daapd"
    select BR2_PACKAGE_LIBAV
    select BR2_PACKAGE_SQLITE
    select BR2_PACKAGE_AVAHI
    select BR2_PACKAGE_AVAHI_DAEMON
    select BR2_PACKAGE_AVAHI_LIBCLIENT
    select BR2_PACKAGE_ZLIB
    select BR2_PACKAGE_LIBUNISTRING
    select BR2_PACKAGE_LIBGCRYPT
    select BR2_PACKAGE_LIBCONFUSE
    select BR2_PACKAGE_MXML
    select BR2_PACKAGE_LIBEVENT
    select BR2_PACKAGE_LIBAVL
    select BR2_PACKAGE_ALSA_LIB
    select BR2_PACKAGE_TRE
    select BR2_PACKAGE_LIBANTLR
    select BR2_PACKAGE_TAGLIB
    help
        forked-daapd is an iTunes server (DAAP server) made by Julian Blache, based on mt-daapd(Firefly). It's also a Roku server(RSP server).
        https://github.com/jasonmc/forked-daapd
```

## package/wdpackage_Dispatcher/Config.in
```kconfig
config BR2_PACKAGE_WDPACKAGE_DISPATCHER
	bool "wdpackage(Dispatcher)"
	help
	  The wd package(Dispatcher) package
```

## package/wdpackage_MediaCrawler/Config.in
```kconfig
config BR2_PACKAGE_WDPACKAGE_MEDIACRAWLER
	bool "wdpackage(MediaCrawler)"
	help
	  The wd package(MediaCrawler) package
```

## package/wdpackage_Notifier/Config.in
```kconfig
config BR2_PACKAGE_WDPACKAGE_NOTIFIER
	bool "wdpackage(Notifier)"
	help
	  The wd package(Notifier) package
```

## package/wdpackage_PlexMediaServer/Config.in
```kconfig
config BR2_PACKAGE_WDPACKAGE_PLEXMEDIASERVER
	bool "wdpackage(PlexMediaServer)"
	help
	  The wd package(PlexMediaServer) package

if BR2_PACKAGE_WDPACKAGE_PLEXMEDIASERVER

config BR2_PACKAGE_WDPACKAGE_PLEXMEDIASERVER_INSTALL_PACKAGE
    bool "PlexMediaServer Package install Method"
    help
      Say 'y' if you want to install PlexMediaServer in install package method

endif
```

## package/wdpackage_RestAPI/Config.in
```kconfig
config BR2_PACKAGE_WDPACKAGE_RESTAPI
	bool "wdpackage(RestAPI)"
	help
	  The wd package(RestAPI) package
```

## package/wdpackage_TwonkyServer/Config.in
```kconfig
config BR2_PACKAGE_WDPACKAGE_TWONKYSERVER
	bool "wdpackage(TwonkyServer)"
	help
	  The wd package(TwonkyServer) package
```

## package/wdpackage_WebUI/Config.in
```kconfig
config BR2_PACKAGE_WDPACKAGE_WEBUI
	bool "wdpackage(WebUI)"
	help
	  The wd package(WebUI) package
```
