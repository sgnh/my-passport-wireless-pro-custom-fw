## package/atop/Config.in
```kconfig
config BR2_PACKAGE_ATOP
	bool "atop (tools)"
	help
	  Atop is an ASCII full-screen performance monitor for Linux (http://www.atoptool.nl/index.php )
```

## package/dpkg/Config.in
```kconfig
config BR2_PACKAGE_DPKG
	bool "dpkg"
	help
	  This package provides the low-level infrastructure for handling
	  the installation and removal of Debian software packages.
	  
	  http://wiki.debian.org/Teams/Dpkg
```

## package/dpkg/Config.in.host
```kconfig
config BR2_PACKAGE_HOST_DPKG
	bool "host dpkg"
	help
	  This package provides the low-level infrastructure for handling
	  the installation and removal of Debian software packages.
	  You could use it from a post-build script, or from project-specific
	  packages, to create .deb files for use on target.

	  http://wiki.debian.org/Teams/Dpkg
```

## package/gphoto2/Config.in
```kconfig
config BR2_PACKAGE_GPHOTO2
	select BR2_PACKAGE_LIBUSB_COMPAT
	select BR2_PACKAGE_LIBUSB
	depends on BR2_PACKAGE_LIBGPHOTO2
	bool "gphoto2"
	help
	  gphoto2 is a command line interface of PTP.

	  http://sourceforge.net/projects/gphoto/files/latest/download
```

## package/gphotofs/Config.in
```kconfig
config BR2_PACKAGE_GPHOTOFS
	select BR2_PACKAGE_LIBUSB_COMPAT
	select BR2_PACKAGE_LIBUSB
	select BR2_PACKAGE_GPHOTO2
	depends on BR2_PACKAGE_LIBGPHOTO2
	bool "gphotofs"
	help
	  gphotofs is a command line interface of PTP mount.

	  http://sourceforge.net/projects/gphoto/files/gphotofs/0.5.0/
```

## package/ifuse/Config.in
```kconfig
config BR2_PACKAGE_IFUSE
	bool "ifuse"
	help
	  A fuse filesystem implementation to access the contents of iOS devices.

	  http://www.libimobiledevice.org/downloads/
```

## package/iotop/Config.in
```kconfig
config BR2_PACKAGE_IOTOP
	bool "iotop"
	depends on BR2_PACKAGE_PYTHON
	select BR2_PACKAGE_NCURSES
	help
      Simple top-like I/O monitor
      
      http://guichaz.free.fr/iotop/
```

## package/libav/Config.in
```kconfig
menuconfig BR2_PACKAGE_LIBAV
	bool "libav"
	#depends on BR2_LARGEFILE
	#depends on BR2_INET_IPV6
	select BR2_PACKAGE_LIBAV_AVCODEC
    select BR2_PACKAGE_LIBAV_SWSCALE
	select BR2_PACKAGE_LIBAV_AVFORMAT
	select BR2_PACKAGE_LIBAV_AVFILTER
	select BR2_PACKAGE_LIBAV_AVDEVICE
	help
         Libav is a complete, cross-platform solution to record, convert
         and stream audio and video.

	 http://www.libav.org

if BR2_PACKAGE_LIBAV

config BR2_PACKAGE_LIBAV_GPL
	bool "Enable GPL code"
	help
         allow use of GPL code, the resulting libs and binaries will
         be under GPL

config BR2_PACKAGE_LIBAV_NONFREE
	bool "Enable nonfree code"
	help
         allow use of nonfree code, the resulting libs and binaries
         will be unredistributable

# not suit for libav-9.12, but available for libavl-0.8.15
#config BR2_PACKAGE_LIBAV_FFMPEG
#	bool "Build ffmpeg (the command line application)"
#	select BR2_PACKAGE_LIBAV_SWSCALE
#	select BR2_PACKAGE_LIBAV_AVCODEC
#	select BR2_PACKAGE_LIBAV_AVFORMAT
#	select BR2_PACKAGE_LIBAV_AVFILTER
#	select BR2_PACKAGE_LIBAV_AVDEVICE
#	default y
#	help
#         FFmpeg is a very fast video and audio converter.
#         It can also grab from a live audio/video source.
#
#         It is not needed if you want to link the Libav libraries
#         to your application.

#config BR2_PACKAGE_LIBAV_FFPLAY
#	bool "Build ffplay"
#	select BR2_PACKAGE_SDL
#	help
#        FFplay is a very simple and portable media player using the
#        Libav libraries and the SDL library.
#        It is mostly used as a testbed for the various Libav APIs.

#config BR2_PACKAGE_LIBAV_FFSERVER
#	bool "Build ffserver"
#	help
#         FFserver is a streaming server for both audio and video.

# not suit for libav-9.12, but available for libavl-0.8.15
#config BR2_PACKAGE_LIBAV_POSTPROC
#	bool "Build libpostproc"
#	depends on BR2_PACKAGE_LIBAV_GPL
#	help
#	  Postproc is a library of video postprocessing routines.

config BR2_PACKAGE_LIBAV_SWSCALE
	bool "Build libswscale"
	default y
    help
	  Swscale is a library of video scaling routines.
	  
config BR2_PACKAGE_LIBAV_AVCODEC
	bool "Build libavcodec"
	default y
    help
	  libavcodec is a free and open-source library of codecs for encoding and decoding video and audio data.

config BR2_PACKAGE_LIBAV_AVFORMAT
	bool "Build libavformat"
	default y
    help
	  The libavformat library provides a generic framework for multiplexing and demultiplexing (muxing and demuxing) audio, video and subtitle streams. It encompasses multiple muxers and demuxers for multimedia container formats.

config BR2_PACKAGE_LIBAV_AVFILTER
	bool "Build libavfilter"
	default y
    help
	  The libavfilter library provides a generic audio/video filtering framework containing several filters, sources and sinks.

config BR2_PACKAGE_LIBAV_AVDEVICE
	bool "Build libavdevice"
	help
	  The libavdevice library provides a generic framework for grabbing from and rendering to many common multimedia input/output devices, and supports several input and output devices, including Video4Linux2, VfW, DShow, and ALSA.

config BR2_PACKAGE_LIBAV_ENCODERS
	string "Enabled encoders"
	default "all"
	help
	 Space-separated list of encoders to build in Libav,
	 or "all" to build all of them.

	 Run ./configure --list-encoders in the Libav sources
	 directory to know the available options.

config BR2_PACKAGE_LIBAV_DECODERS
	string "Enabled decoders"
	default "all"
	help
	 Space-separated list of decoders to build in Libav,
	 or "all" to build all of them.

	 Run ./configure --list-decoders in the Libav sources
	 directory to know the available options.

config BR2_PACKAGE_LIBAV_MUXERS
	string "Enabled muxers"
	default "all"
	help
	 Space-separated list of muxers to build in Libav,
	 or "all" to build all of them.

	 Run ./configure --list-muxers in the Libav sources
	 directory to know the available options.

config BR2_PACKAGE_LIBAV_DEMUXERS
	string "Enabled demuxers"
	default "all"
	help
	 Space-separated list of demuxers to build in Libav,
	 or "all" to build all of them.

	 Run ./configure --list-demuxers in the Libav sources
	 directory to know the available options.

config BR2_PACKAGE_LIBAV_PARSERS
	string "Enabled parsers"
	default "all"
	help
	 Space-separated list of parsers to build in Libav,
	 or "all" to build all of them.

	 Run ./configure --list-parsers in the Libav sources
	 directory to know the available options.

config BR2_PACKAGE_LIBAV_BSFS
	string "Enabled bitstreams"
	default "all"
	help
	 Space-separated list of bitstream filters to build in Libav,
	 or "all" to build all of them.

	 Run ./configure --list-bsfs in the Libav sources
	 directory to know the available options.

config BR2_PACKAGE_LIBAV_PROTOCOLS
	string "Enabled protocols"
	default "all"
	help
	 Space-separated list of protocols to build in Libav,
	 or "all" to build all of them.

	 Run ./configure --list-protocols in the Libav sources
	 directory to know the available options.

config BR2_PACKAGE_LIBAV_FILTERS
	string "Enabled filters"
	default "all"
	help
	 Space-separated list of filters to build in Libav,
	 or "all" to build all of them.

	 Run ./configure --list-filters in the Libav sources
	 directory to know the available options.

config BR2_PACKAGE_LIBAV_INDEVS
	bool "Enable input devices"
	default y

config BR2_PACKAGE_LIBAV_OUTDEVS
	bool "Enable output devices"
	default y

config BR2_PACKAGE_LIBAV_EXTRACONF
	string "Additional parameters for ./configure"
	default ""
	help
	 Extra parameters that will be appended to Libav's
	 ./configure commandline.

endif
```

## package/libavl/Config.in
```kconfig
config BR2_PACKAGE_LIBAVL
	bool "libavl"
	help
	  GNU libavl is the most complete, well-documented collection of binary search tree and balanced tree library routines anywhere

	  http://www.debian.co.il/debian/pool/main/liba/libavl/
```

## package/libgphoto2/Config.in
```kconfig
config BR2_PACKAGE_LIBGPHOTO2
	select BR2_PACKAGE_LIBUSB_COMPAT
	select BR2_PACKAGE_LIBUSB
	bool "libgphoto2"
	help
	  libgphoto2 is a LGPL library implementation of MTP and PTP.

	  http://sourceforge.net/projects/gphoto/files/latest/download
```

## package/libimobiledevice/Config.in
```kconfig
config BR2_PACKAGE_LIBIMOBILEDEVICE
	depends on BR2_PACKAGE_LIBPLIST
	bool "libimobiledevice"
	help
	  A library to communicate with services of Apple iOS devices using native protocols.

	  http://www.libimobiledevice.org/downloads/
```

## package/libmtp/Config.in
```kconfig
config BR2_PACKAGE_LIBMTP
	select BR2_PACKAGE_LIBUSB_COMPAT
	select BR2_PACKAGE_LIBUSB
	bool "libmtp"
	help
	  libmtp is a LGPL library implementation of the Media Transfer Protocol (MTP), a superset of the Picture Transfer Protocol (PTP).

	  http://sourceforge.net/projects/libmtp/files/latest/download

comment "full MTP initiator implementation library for Linux, MacOS and *BSD"
	
```

## package/libunistring/Config.in
```kconfig
config BR2_PACKAGE_LIBUNISTRING
	bool "libunistring"
	help
	  manipulating Unicode strings and for manipulating C strings according to the Unicode standard

	  http://www.linuxfromscratch.org/blfs/view/svn/general/libunistring.html
```

## package/libusbmuxd/Config.in
```kconfig
config BR2_PACKAGE_LIBUSBMUXD
	depends on BR2_PACKAGE_LIBUSB_COMPAT
	depends on BR2_PACKAGE_LIBUSB
	depends on BR2_PACKAGE_LIBPLIST
	bool "libusbmuxd"
	help
	  A client library to multiplex connections from and to iOS devices by connecting to a socket provided by a usbmuxd daemon.

	  https://github.com/libimobiledevice/libusbmuxd.git
```

## package/lld2d/Config.in
```kconfig
config BR2_PACKAGE_LLD2D
	bool "lld2d"
	help
        Link Layer Topology Discovery
```

## package/lsb/Config.in
```kconfig
config BR2_PACKAGE_LSB
	bool "lsb"
	select BR2_PACKAGE_NCURSES
	help
      Linux Standard Base 4.1 core support package
```

## package/mtpfs/Config.in
```kconfig
config BR2_PACKAGE_MTPFS
	depends on BR2_PACKAGE_LIBMTP
    select BR2_PACKAGE_LIBGLIB2
    bool "mtpfs"
	help
	  MTPfs is a FUSE filesystem that supports reading and writing from any MTP device (as supported by libmtp)

	  http://www.adebenham.com/files/mtp/mtpfs-1.1.tar.gz

	
```

## package/net-tools/Config.in
```kconfig
config BR2_PACKAGE_NET_TOOLS
	bool "net-tools"
	select BR2_PACKAGE_NCURSES
	help
      The NET-3 networking toolkit

      http://net-tools.berlios.de/

config BR2_PACKAGE_NET_TOOLS_ARP
    bool "arp"
    depends on BR2_PACKAGE_NET_TOOLS
    help
      manipulate the system ARP cache

config BR2_PACKAGE_NET_TOOLS_IFCONFIG
    bool "ifconfig"
    depends on BR2_PACKAGE_NET_TOOLS
    help
      configure a network interface

config BR2_PACKAGE_NET_TOOLS_NAMEIF
    bool "nameif"
    depends on BR2_PACKAGE_NET_TOOLS
    help
      name network interfaces based on MAC addresses

config BR2_PACKAGE_NET_TOOLS_NETSTAT
    bool "netstat"
    depends on BR2_PACKAGE_NET_TOOLS
    help
      Print network connections, routing tables, interface statistics, masquerade connections, and multicast memberships

config BR2_PACKAGE_NET_TOOLS_PLIPCONFIG
    bool "plipconfig"
    depends on BR2_PACKAGE_NET_TOOLS
    help
      fine tune PLIP device parameters

config BR2_PACKAGE_NET_TOOLS_RARP
    bool "rarp"
    depends on BR2_PACKAGE_NET_TOOLS
    help
      manipulate the system RARP table

config BR2_PACKAGE_NET_TOOLS_ROUTE
    bool "route"
    depends on BR2_PACKAGE_NET_TOOLS
    help
      show manipulate the IP routing table

config BR2_PACKAGE_NET_TOOLS_SLATTACH
    bool "slattach"
    depends on BR2_PACKAGE_NET_TOOLS
    help
      attach a network interface to a serial line 
```

## package/php/Config.in
```kconfig
config BR2_PACKAGE_PHP
	bool "php"
	help
	  PHP  is a widely-used general-purpose scripting
	  language that is especially suited for Web development
	  and can be embedded into HTML.

	  http://www.php.net

if BR2_PACKAGE_PHP

source "package/php/Config.ext"

config BR2_PACKAGE_PHP_APACHE
       bool

config BR2_PACKAGE_PHP_CLI
       bool

config BR2_PACKAGE_PHP_CGI
       bool

choice
        prompt "Interface"
        default BR2_PACKAGE_PHP_SAPI_CGI
        help
          Select the PHP interface(s).

config BR2_PACKAGE_PHP_SAPI_APACHE
	bool "Apache"
	select BR2_PACKAGE_APACHE
	select BR2_PACKAGE_PHP_APACHE
	depends on !BR2_STATIC_LIBS # apache
	depends on BR2_TOOLCHAIN_HAS_THREADS # apache
	depends on BR2_USE_MMU # apr
	help
	  Apache module

comment "apache module needs a toolchain w/ dynamic library, threads"
	depends on BR2_USE_MMU
	depends on BR2_STATIC_LIBS || !BR2_TOOLCHAIN_HAS_THREADS

config BR2_PACKAGE_PHP_SAPI_CGI
	bool "CGI"
	# CGI uses fork()
	depends on BR2_USE_MMU
	select BR2_PACKAGE_PHP_CGI
	help
	  Common Gateway Interface

config BR2_PACKAGE_PHP_SAPI_CLI
        bool "CLI"
	select BR2_PACKAGE_PHP_CLI
        help
          Command Line Interface

config BR2_PACKAGE_PHP_SAPI_CLI_CGI
        bool "CLI, APACHE"
	# CGI uses fork()
	depends on BR2_USE_MMU
	select BR2_PACKAGE_PHP_CLI
	select BR2_PACKAGE_PHP_APACHE
	help
	  Command line and Common gateway interfaces

endchoice

endif
```

## package/pmxpackage_asmupdate/Config.in
```kconfig
config BR2_PACKAGE_PMXPACKAGE_ASMUPDATE
	bool "pmxpackage(asmupdate)"
	help
	  The primax package(asmupdate) ASMedia FW udpate tool for Korra device

if BR2_PACKAGE_PMXPACKAGE_ASMUPDATE
config BR2_PACKAGE_PMXPACKAGE_ASMUPDATE_STATIC
    bool "compile as static"
    help
      Enable static mode

endif
```

## package/pmxpackage_defaultsettings/Config.in
```kconfig
config BR2_PACKAGE_PMXPACKAGE_DEFAULTSETTINGS
	bool "pmxpackage(defaultsettings)"
	help
	  The primax package(defaultsettings) Default settings for MyPassport device
```

## package/pmxpackage_fwdescriptor/Config.in
```kconfig
config BR2_PACKAGE_PMXPACKAGE_FWDESCRIPTOR
	bool "pmxpackage(fwdescriptor)"
	help
	  The primax package(fwdescriptor) SPI flash FW udpate tool for Korra device
```

## package/pmxpackage_fwupg/Config.in
```kconfig
config BR2_PACKAGE_PMXPACKAGE_FWUPG
	bool "pmxpackage(fwupg)"
	help
	  The primax package(fwupg) FWUPG script for Avatar device
```
